## recipes-bsp/u-boot/files/rda8810-stage2/arch/arm/mach-rda/Kconfig
```kconfig
if ARCH_RDA

config SYS_SOC
	default "rda"

config SYS_BOARD
	default "rda8810pl"

config SYS_VENDOR
	default "rda"

config SYS_CONFIG_NAME
	default "rda8810pl"

config RDA_ISPI
	bool "RDA8810PL internal SPI (ISPI) transport"
	help
	  The ISPI is how the SoC reaches its analog blocks: port 0 is the AP's
	  own baseband (PLLs), port 1 is the PMU that holds every v_* LDO and
	  the low-frequency clock outputs. Under the vendor system the modem
	  coprocessor owns port 1; with no modem running, u-boot does.

source "board/rda/rda8810pl/Kconfig"

endif
```

## recipes-bsp/u-boot/files/rda8810-stage2/board/rda/rda8810pl/Kconfig
```kconfig
# board options for OrangePi i96 (RDA8810PL)

if ARCH_RDA

config RDA_COMBO_POWER
	bool "RDA599x WiFi/BT combo power bring-up (rdacombo/rdapmu commands)"
	depends on DM_I2C
	select RDA_ISPI
	help
	  Build the "rdacombo" and "rdapmu" commands, which reach the SoC's PMU
	  over ISPI and try to switch on the RDA5991_G WiFi/BT combo chip that
	  the modem coprocessor normally powers. This is the strategy-A' bench
	  instrument described in recipes-kernel/linux/files/MODEM-WIFI-PORT.md;
	  it costs a couple of KB and gives an in-u-boot pass/fail for the WiFi
	  power problem instead of a Linux boot per attempt.

config RDA_COMBO_POWER_AUTO
	bool "Latch the combo chip on during board_init()"
	depends on RDA_COMBO_POWER
	help
	  Run the PMU sequence from board_init() on every boot, so Linux
	  inherits a powered combo chip and never needs mdcom/msys.

	  Leave this off until the bench has confirmed which PMU register and
	  bit actually is v_bt ("rdacombo scan"): until then the compiled-in
	  sequence is only a hypothesis, and poking a guessed PMU bit on every
	  boot is not something a bootloader should do unattended.

endif
```
